## CMakeLists.txt
```
# Zephyr out-of-tree sample: ZTEST on native_sim + mulation instrumentation.
#
#   west build -b native_sim -d build-native path/to/examples/zephyr-ztest-native
#   ./build-native/zephyr/zephyr.exe
#   mulation --git-diff -j 4 -- ./build-native/zephyr/zephyr.exe
#
# Requires ZEPHYR_BASE and an LLVM/Clang Zephyr toolchain (pass plugin).

cmake_minimum_required(VERSION 3.20.0)
find_package(Zephyr REQUIRED HINTS $ENV{ZEPHYR_BASE})
project(mulation_zephyr_ztest_native)

target_sources(app PRIVATE
  src/compare.c
  src/compare_test.c
)
target_include_directories(app PRIVATE ${CMAKE_CURRENT_SOURCE_DIR}/src)

# --- mulation: instrument SUT only (not ZTEST / Zephyr) ---
set(_mulation_prefix "$ENV{HOME}/.local")
if(DEFINED ENV{MULATION_PREFIX} AND NOT "$ENV{MULATION_PREFIX}" STREQUAL "")
  set(_mulation_prefix "$ENV{MULATION_PREFIX}")
endif()
set(_mulation_plugin "${_mulation_prefix}/lib/libmulation_plugin.so")
set(_mulation_runtime "${_mulation_prefix}/lib/libmulation_runtime.a")
set(_mulation_inc "${_mulation_prefix}/include")

if(EXISTS "${_mulation_plugin}" AND EXISTS "${_mulation_runtime}")
  message(STATUS "mulation: instrumenting src/compare.c via ${_mulation_plugin}")
  set_source_files_properties(src/compare.c PROPERTIES
    COMPILE_OPTIONS "-g;-fpass-plugin=${_mulation_plugin}"
  )
  target_include_directories(app PRIVATE ${_mulation_inc})
  target_link_libraries(app PRIVATE ${_mulation_runtime})
else()
  message(WARNING
    "mulation plugin/runtime not found under ${_mulation_prefix}/lib — "
    "building without instrumentation. Install mulation or set MULATION_PREFIX.")
endif()
```

## prj.conf
```kconfig
CONFIG_ZTEST=y
# Host board: west build -b native_sim
```

## src/compare.c
```c
#include "compare.h"

int is_adult(int age) {
    /* Weak contract demo: boundary 18 often untested in ZTEST. */
    return age >= 18;
}

int max2(int a, int b) {
    return a > b ? a : b;
}

int add2(int a, int b) {
    return a + b;
}
```

## src/compare.h
```c
#ifndef COMPARE_H
#define COMPARE_H

#ifdef __cplusplus
extern "C" {
#endif

int is_adult(int age);
int max2(int a, int b);
int add2(int a, int b);

#ifdef __cplusplus
}
#endif

#endif
```

## src/compare_test.c
```c
/*
 * Intentionally weak ZTEST suite (same story as examples/gtest-ctest).
 * Green + coverage can still miss age 18; mulation should report survivors.
 */
#include <zephyr/ztest.h>

#include "compare.h"

ZTEST_SUITE(compare, NULL, NULL, NULL, NULL, NULL);

ZTEST(compare, adult_twenty) {
    zassert_true(is_adult(20), "20 should be adult");
}

ZTEST(compare, max_unequal) {
    zassert_equal(max2(5, 3), 5, "max2");
}

ZTEST(compare, add_two_plus_two) {
    /* Kills + -> -; + -> * may still survive (2*2 == 4). */
    zassert_equal(add2(2, 2), 4, "add2");
}

/*
 * Uncomment to kill surviving boundary / arithmetic mutants:
 *
 * ZTEST(compare, adult_boundary)
 * {
 *         zassert_true(is_adult(18), "18 inclusive");
 *         zassert_false(is_adult(17), "17 not adult");
 * }
 *
 * ZTEST(compare, add_three_plus_one)
 * {
 *         zassert_equal(add2(3, 1), 4, "kills + -> *");
 * }
 */
```
